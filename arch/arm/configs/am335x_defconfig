## its/am335x-moxa-aig-100.its
```
/*
 * U-Boot itb image source file for "aig100 project"
 */

/dts-v1/;

/ {
	description = "U-Boot itb image source file for aig100 project";
	#address-cells = <1>;
	
	images {
		kernel@aig100 {
			description = "Moxa AIG100 Series Unify Linux Kernel";
			data = /incbin/("../arch/arm/boot/zImage");
			type = "kernel";
			arch = "arm";
			os = "linux";
			compression = "none";
			load = <0x80080000>;
			entry = <0x80080000>;
		};
		fdt@aig101 {
			description = "Flattened Device Tree blob for aig101";
			data = /incbin/("../arch/arm/boot/dts/am335x-moxa-aig-101.dtb");
			type = "flat_dt";
			arch = "arm";
			compression = "none";
			load = <0x80000000>;
		};
	};
	
	configurations {
		default = "aig101";
		aig101 {
			description = "Boot Linux kernel with aig101 FDT blob";
			kernel = "kernel@aig100";
			fdt = "fdt@aig101";
		};
	};
};
```

## its/am335x-moxa-vg-100.its
```
/*
 * U-Boot itb image source file for "vg100 project"
 */

/dts-v1/;

/ {
	description = "U-Boot itb image source file for vg100 project";
	#address-cells = <1>;
	
	images {
		kernel@vg100 {
			description = "Moxa VG100 Series Unify Linux Kernel";
			data = /incbin/("../arch/arm/boot/zImage");
			type = "kernel";
			arch = "arm";
			os = "linux";
			compression = "none";
			load = <0x80080000>;
			entry = <0x80080000>;
		};
		fdt@vg101 {
			description = "Flattened Device Tree blob for vg101";
			data = /incbin/("../arch/arm/boot/dts/am335x-moxa-vg-101.dtb");
			type = "flat_dt";
			arch = "arm";
			compression = "none";
			load = <0x80000000>;
		};
	};
	
	configurations {
		default = "vg101";
		vg101 {
			description = "Boot Linux kernel with vg101 FDT blob";
			kernel = "kernel@vg100";
			fdt = "fdt@vg101";
		};
	};
};
```

## its/imx7d-moxa-uc-8200.its
```
/*
 * U-Boot itb image source file for "uc8200 project"
 */

/dts-v1/;

/ {
	description = "U-Boot itb image source file for uc8200 project";
	#address-cells = <1>;

	images {
		kernel@uc8200 {
			description = "Moxa UC8200 Series Unify Linux Kernel";
			data = /incbin/("../arch/arm/boot/zImage");
			type = "kernel";
			arch = "arm";
			os = "linux";
			compression = "none";
			load = <0x80800000>;
			entry = <0x80800000>;
		};
		fdt@uc8210 {
			description = "Flattened Device Tree blob for UC8200";
			data = /incbin/("../arch/arm/boot/dts/imx7d-moxa-uc-8210.dtb");
			type = "flat_dt";
			arch = "arm";
			compression = "none";
			load = <0x83000000>;
		};
		fdt@uc8220 {
			description = "Flattened Device Tree blob for UC8200";
			data = /incbin/("../arch/arm/boot/dts/imx7d-moxa-uc-8220.dtb");
			type = "flat_dt";
			arch = "arm";
			compression = "none";
			load = <0x83000000>;
		};
	};

	configurations {
		default = "uc8220";
		uc8210 {
			description = "Boot Linux kernel with uc8200 FDT blob";
			kernel = "kernel@uc8200";
			fdt = "fdt@uc8210";
		};
		uc8220 {
			description = "Boot Linux kernel with uc8200 FDT blob";
			kernel = "kernel@uc8200";
			fdt = "fdt@uc8220";
		};
	};
};
```
